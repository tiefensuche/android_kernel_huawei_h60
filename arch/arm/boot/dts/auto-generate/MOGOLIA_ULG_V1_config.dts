/*
 * Hisilicon Ltd.
 *
 * A15x4 A7x4
 *
 * It is only a demo for hisilicon hi3630 board. You show change the
 * address of each node according to datasheet.
 */

/dts-v1/;

/include/ "fastboot.dtsi"
/include/ "MOGOLIA_TL_V1_config.dtsi"
/include/ "MOGOLIA_ULG_V1_pin.dtsi"
/include/ "MOGOLIA_ULG_V1_modem_pin.dtsi"

/ {
		hisi,boardid = <9 2 0 7>;
		hisi,boardname = "MOGOLIA_ULG_V1";
		hisi,modem_id = <0x3fb51000>;

	audio_hal_config {
		aud_para = "MOGOLIA_ULG";
	};

	bcm_wifi {
		wifi_nvram_name = "/vendor/firmware/nvram4334_hw_mogolia_ulg.txt";
		wifi_fw_name = "/vendor/firmware/fw_bcm4334_hw_dualband.bin";
		wifi_fw_ap_name = "/vendor/firmware/fw_bcm4334_apsta_hw_dualband.bin";
		wifi_fw_test_name = "/vendor/firmware/fw_bcm4334_test_hw_apsta_dualband.bin";
		udp_board;
		ic_type= "bcm4334";
		status = "ok";
	};

};
