/*
 * Hisilicon Ltd.
 *
 * A15x4 A7x4
 *
 * It is only a demo for hisilicon hi3630 board. You show change the
 * address of each node according to datasheet.
 */

/dts-v1/;

/include/ "fastboot.dtsi"
/include/ "MOGOLIA_TL_V3_config.dtsi"
/include/ "MOGOLIA_TL_2GFreq_pin.dtsi"
/include/ "MOGOLIA_TL_2GFreq_modem_pin.dtsi"

/ {
	hisi,boardid = <9 2 3 7>;
	hisi,boardname = "MOGOLIA_TL_2GFreq";
	hisi,config_profile = "superhigh";

	cpus {
		/* customize operating-points for A15 */
		cpu4: cpu@4 {
			operating-points = <
				/* kHz */
				/* 508800  0 */
				806400  0
				1017600 0
				1209600 0
				1382400 0
				1497600 0
				1708800 0
				1804800 0
				2016000 0
       >;
     };
	};

	target-cpu {
		compatible = "hisi,targetcpu";
		target_cpu = "Kirin 928";
	};

};
